/dts-v1/;
/plugin/;

/ {
    compatible = "brcm,bcm2712"; //raspberry pi 5
    
    fragment@0 {
        target = <&i2c1>;
        __overlay__ {
            #address-cells = <1>;
            #size-cells = <0>;
            status = "okay";

            slave: uno@55 {
                compatible = "arduino,uno";
                reg = <0x55>;
            };
        };
    };
};  